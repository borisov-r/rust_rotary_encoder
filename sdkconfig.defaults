## sdkconfig.defaults
```kconfig
# ESP32 SDK Configuration
# This file contains essential ESP-IDF configuration for the rotary encoder application

# Enable GPIO support
CONFIG_GPIO_ESP32_SUPPORT_SWITCH_SLP_PULL=y

# UART configuration for serial output
CONFIG_ESP_CONSOLE_UART_DEFAULT=y
CONFIG_ESP_CONSOLE_UART_NUM=0
CONFIG_ESP_CONSOLE_UART_BAUDRATE=115200

# Enable debug features
CONFIG_LOG_DEFAULT_LEVEL_DEBUG=y
CONFIG_LOG_MAXIMUM_LEVEL_VERBOSE=y

# FreeRTOS configuration for better interrupt handling
CONFIG_FREERTOS_HZ=1000

# ESP32 specific
CONFIG_ESP32_DEFAULT_CPU_FREQ_240=y
```
